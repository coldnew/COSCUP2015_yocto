## meta-coscup/conf/distro/coscup.conf
```bitbake
# base on poky
require conf/distro/poky.conf

DISTRO = "coscup"
DISTRO_NAME = "Coscup (Example distro)"
DISTRO_VERSION = "1.0"

MAINTAINER = "Yen-Chin, Lee"

# Many config in local.conf can move here
DISTRO_FEATURES_append = " wayland"

# Use systemd as our runtime services
VIRTUAL-RUNTIME_init_manager ?= "systemd"
VIRTUAL-RUNTIME_initscripts ?= ""
DISTRO_FEATURES_append = " systemd"
DISTRO_FEATURES_BACKFILL_CONSIDERED = "sysvinit"

# Uncomment this for use uclibc instead of glibc
# TCLIBC = "uclibc"
```

## meta-coscup/conf/layer.conf
```bitbake
# We have a conf and classes directory, add to BBPATH
BBPATH .= ":${LAYERDIR}"

# We have recipes-* directories, add to BBFILES
BBFILES += "${LAYERDIR}/recipes-*/*/*.bb \
	${LAYERDIR}/recipes-*/*/*.bbappend"

BBFILE_COLLECTIONS += "coscup"
BBFILE_PATTERN_coscup = "^${LAYERDIR}/"
BBFILE_PRIORITY_coscup = "6"
```
